## sdkconfig.defaults
```kconfig
# Override some defaults
#
# - enable BT nimble stack
#   (from examples/bluetooth/nimble/blehr)
# - enlarge usable flash size
#

#
# BT config
#
CONFIG_BT_ENABLED=y
CONFIG_BT_BLUEDROID_ENABLED=n
CONFIG_BT_NIMBLE_ENABLED=y
CONFIG_BT_NIMBLE_50_FEATURE_SUPPORT=n
# we call NIMBLE functions out of that task.
# need a little more stack
CONFIG_FREERTOS_TIMER_TASK_STACK_DEPTH=4096
# CONFIG_BT_NIMBLE_HOST_TASK_STACK_SIZE=8000

# CONFIG_BTDM_CTRL_MODE_BLE_ONLY=y
# CONFIG_BTDM_CTRL_MODE_BR_EDR_ONLY=n
# CONFIG_BTDM_CTRL_MODE_BTDM=n


#
# Partition Table
#
CONFIG_PARTITION_TABLE_CUSTOM=y
CONFIG_PARTITION_TABLE_CUSTOM_FILENAME="partitions.csv"
CONFIG_PARTITION_TABLE_FILENAME="partitions.csv"

# we use RTTI for serializing and deserializing
CONFIG_COMPILER_CXX_RTTI=y

CONFIG_HEAP_TASK_TRACKING=y

# or else sound would stop when adc input module is active
CONFIG_ADC_DISABLE_DAC_OUTPUT=n
# we use this
CONFIG_SOC_DAC_DMA_16BIT_ALIGN=y
```
